## conf/distro/imdt.conf
```bitbake
require conf/distro/rz-vlp.conf

DISTRO = "imdt"
DISTRO_NAME = "IMDT (Renesas RZ)"
BB_ENV_PASSTHROUGH_ADDITIONS:append = " IMDT_DISTRO_VERSION"
IMDT_DISTRO_VERSION ?= "0.0.0"
DISTRO_VERSION = "${IMDT_DISTRO_VERSION}"
DISTROOVERRIDES = "rz-bsp:rz-vlp:imdt"

SYSTEMD_AUTO_ENABLE:pn-auditd = "disable"

# Package configuration
PACKAGE_CLASSES ?= "package_rpm"

# License flags
LICENSE_FLAGS_ACCEPTED = " \
    commercial_gstreamer1.0-plugins-ugly \
    commercial_mpeg2dec \
    commercial_gst-plugins-bad \
    commercial_faad2 \
    commercial_faac \
    commercial_gstreamer1.0-libav \
    commercial_ffmpeg commercial_x264 \
"

# Build info in image
INHERIT += "image-buildinfo"

# Debian snapshot mirrors for reproducible builds
PREMIRRORS += " \
    http://security.debian.org/debian-security/ https://snapshot.debian.org/archive/debian-security/20240701T000000Z/ \n \
    https://security.debian.org/debian-security/ https://snapshot.debian.org/archive/debian-security/20240701T000000Z/ \n \
    http://deb.debian.org/debian/ https://snapshot.debian.org/archive/debian/20240701T000000Z/ \n \
    https://deb.debian.org/debian/ https://snapshot.debian.org/archive/debian/20240701T000000Z/ \n \
    http://ftp.debian.org/debian/ https://snapshot.debian.org/archive/debian/20240701T000000Z/ \n \
    https://ftp.debian.org/debian/ https://snapshot.debian.org/archive/debian/20240701T000000Z/ \n \
    https://ftp.gnu.org/ https://ftpmirror.gnu.org/ \n \
    http://ftp.gnu.org/ https://ftpmirror.gnu.org/ \n \
"

PACKAGECONFIG:append:pn-gstreamer1.0-plugins-ugly = " x264"
```

## conf/layer.conf
```bitbake
# We have a conf and classes directory, add to BBPATH
BBPATH .= ":${LAYERDIR}"

# We have recipes-* directories, add to BBFILES
BBFILES += "${LAYERDIR}/recipes-*/*/*.bb \
            ${LAYERDIR}/recipes-*/*/*.bbappend"

BBFILES_DYNAMIC += "\
     meta-rz-codecs:${LAYERDIR}/dynamic-layers/meta-rz-codecs/recipes-*/*/*.bbappend \
     meta-rz-graphics:${LAYERDIR}/dynamic-layers/meta-rz-graphics/recipes-*/*/*.bbappend \
     meta-rz-codecs:${LAYERDIR}/dynamic-layers/recipes-*/*/*.bbappend \
     rz-drpai:${LAYERDIR}/dynamic-layers/meta-rz-drpai/recipes-*/*/*.bb \
     rz-drpai:${LAYERDIR}/dynamic-layers/meta-rz-drpai/recipes-*/*/*.bbappend \
"

BBFILE_COLLECTIONS += "imdt-renesas"
BBFILE_PATTERN_imdt-renesas = "^${LAYERDIR}/"
BBFILE_PRIORITY_imdt-renesas = "20"
LAYERDEPENDS_imdt-renesas = "meta-rz-bsp meta-rz-distro swupdate"

LAYERSERIES_COMPAT_imdt-renesas = "scarthgap"
```

## conf/machine/imdt-v2h-sbc.conf
```bitbake
#@TYPE: Machine
#@NAME: imdt-v2h-sbc machine
#@DESCRIPTION: IMDT V2H Single Board Computer

require conf/machine/include/rzv2h-family.inc
require conf/machine/include/imdt-v2-sbc.inc

# Add SoC part number to overrides so COMPATIBLE_MACHINE patterns match
MACHINEOVERRIDES =. "r9a09g057:rzv2h-evk:"

IMAGE_BOOT_FILES += " \
    Flash_Writer_SCIF_RZV2H_DEV_INTERNAL_MEMORY.mot \
"
TFA_PLATFORM = "v2h"
UBOOT_CONFIG = "imdt-v2h-sbc"

# Set u-boot defconfig to use
UBOOT_CONFIG[imdt-v2h-sbc] = "${MACHINE}_defconfig"
```

## conf/machine/imdt-v2n-sbc.conf
```bitbake
#@TYPE: Machine
#@NAME: imdt-v2n-sbc machine
#@DESCRIPTION: IMDT RZ/V2N Single board computer

require conf/machine/include/rzv2n-family.inc
require conf/machine/include/imdt-v2-sbc.inc

# Add SoC part number to overrides so COMPATIBLE_MACHINE patterns match
MACHINEOVERRIDES .= "r9a09g056:rzv2n-evk"

IMAGE_BOOT_FILES += " \
    Flash_Writer_SCIF_RZV2N_DEV_LPDDR4X.mot \
"

TFA_PLATFORM = "v2n"

UBOOT_CONFIG = "imdt-v2n-sbc"

# Set u-boot defconfig to use
UBOOT_CONFIG[imdt-v2n-sbc] = "${MACHINE}_defconfig"
```

## conf/machine/include/imdt-v2-sbc.inc
```bitbake
require conf/machine/include/arm/armv8-2a/tune-cortexa55.inc
require conf/machine/include/rz-common.inc

SERIAL_CONSOLES ?= "115200;ttySC0"
PREFERRED_VERSION_trusted-firmware-a ?= "2.10%"
TFA_BOARD ?= "evk_1"
TFA_UBOOT ?= "1"
TFA_BUILD_TARGET ?= "bl2 bl31 fip"
BL2_BOOT_TARGET ?= "spi mmc esd"
EXTRA_IMAGEDEPENDS += " firmware-pack"

BL2_BASE_ADDR ?= "0x08103000"
BL2_ADJUST_VMA ?= "0x08101E00"
FIP_ADJUST_VMA ?= "0x0"

# U-Boot Configuration
PREFERRED_VERSION_u-boot = "2024.07%"

PREFERRED_PROVIDER_virtual/kernel = "linux-renesas"
PREFERRED_VERSION_linux-renesas ?= "6.1%"
# Kernel Configuration

# flash writer
EXTRA_IMAGEDEPENDS += " flash-writer"

# firmware pack
EXTRA_IMAGEDEPENDS += " firmware-pack"

# Add the HDMI and panel device tree files
KERNEL_DEVICETREE = " \
	renesas/imdt-v2-sbc-dsi-hdmi.dtbo \
	renesas/imdt-v2-sbc-dsi-panel.dtbo \
	renesas/${MACHINE}.dtb \
	renesas/imdt-v2-sbc-ar1335-csi2.dtbo \
	renesas/imdt-v2-sbc-ar1335-csi3.dtbo \
"
IMAGE_INSTALL:remove = " optee-client"

IMAGE_BOOT_FILES = " \
	u-boot-env.img \
"
KERNEL_DTC_FLAGS += " -@"

# Wic image
WKS_FILE = "imdt-image.wks"
do_image_wic[depends] += "firmware-pack:do_deploy"
# 4K alignment for fastboot support
IMAGE_ROOTFS_ALIGNMENT ?= "4"
```

## docs/template/conf/bblayers.conf.sample
```bitbake
# POKY_BBLAYERS_CONF_VERSION is increased each time build/conf/bblayers.conf
# changes incompatibly
POKY_BBLAYERS_CONF_VERSION = "2"

BBPATH = "${TOPDIR}"
BBFILES ?= ""

IMDT_INTERNAL = "${TOPDIR}/../sources/meta-imdt-renesas-internal"
RZ_FEATURE_DRPAI_V2N = "${TOPDIR}/../sources/renesas-layers/rzv2n_drp-ai_driver/meta-rz-features/meta-rz-drpai"
RZ_FEATURE_DRPAI_V2H = "${TOPDIR}/../sources/renesas-layers/rzv2h_drp-ai_driver/meta-rz-features/meta-rz-drpai"
RZ_FEATURE_OPENCVA_V2N = "${TOPDIR}/../sources/renesas-layers/rzv2n_opencv_accelerator/meta-rz-features/meta-rz-opencva"
RZ_FEATURE_OPENCVA_V2H = "${TOPDIR}/../sources/renesas-layers/rzv2h_opencv_accelerator/meta-rz-features/meta-rz-opencva"
RZ_FEATURE_CODEC = "${TOPDIR}/../sources/meta-rz-features/meta-rz-codecs"
RZ_FEATURE_GRAPHICS = "${TOPDIR}/../sources/meta-rz-features/meta-rz-graphics"


HAS_IMDT_INTERNAL = "${@os.path.isdir('${IMDT_INTERNAL}')}"
HAS_RZ_FEATURE_DRPAI_V2N = "${@os.path.isdir('${RZ_FEATURE_DRPAI_V2N}')}"
HAS_RZ_FEATURE_DRPAI_V2H = "${@os.path.isdir('${RZ_FEATURE_DRPAI_V2H}')}"
HAS_RZ_FEATURE_OPENCVA_V2N = "${@os.path.isdir('${RZ_FEATURE_OPENCVA_V2N}')}"
HAS_RZ_FEATURE_OPENCVA_V2H = "${@os.path.isdir('${RZ_FEATURE_OPENCVA_V2H}')}"
HAS_RZ_FEATURE_CODEC = "${@os.path.isdir('${RZ_FEATURE_CODEC}')}"
HAS_RZ_FEATURE_GRAPHICS = "${@os.path.isdir('${RZ_FEATURE_GRAPHICS}')}"

# NOTE
# There are some feature layers that can cause conflicts. This varies between platforms (i.e. V2N and V2H have different rules). 
# When multiple conflicting layers are present, only one is included. The layer that is included follows the following prioirty:

# Layer prioirities for V2H - OPENCVA and CODECS conflict.
# 1. CODECS
# 2. OPENCVA

RZ_FEATURE_V2H_CODEC_OCVA = "${@ \
    ('${RZ_FEATURE_CODEC}' if '${HAS_RZ_FEATURE_CODEC}' == 'True' else \
     ('${RZ_FEATURE_OPENCVA_V2H}' if '${HAS_RZ_FEATURE_OPENCVA_V2H}' == 'True' else '')) \
    if '${MACHINE}' == 'imdt-v2h-sbc' else '' \
}"


V2H_DRPAI = "${@ \
    ('${RZ_FEATURE_DRPAI_V2H}' if '${HAS_RZ_FEATURE_DRPAI_V2H}' == 'True' else '') \
    if '${MACHINE}' == 'imdt-v2h-sbc' else '' \
}"

# Layer Priorities for V2N - OPENCVA, CODECS and DRPAI conflict.
# 1. DRPAI
# 2. CODECS
# 3. OPENCVA

RZ_FEATURE_V2N_DRPAI_CODEC_OCVA = "${@ \
('${RZ_FEATURE_DRPAI_V2N}' if '${HAS_RZ_FEATURE_DRPAI_V2N}' == 'True' else \
     ('${RZ_FEATURE_CODEC}' if '${HAS_RZ_FEATURE_CODEC}' == 'True' else \
      ('${RZ_FEATURE_OPENCVA_V2N}' if '${HAS_RZ_FEATURE_OPENCVA_V2N}' == 'True' else ''))) \
    if '${MACHINE}' == 'imdt-v2n-sbc' else '' \
}"

# Order of precedence for 
BBLAYERS ?= " \
  ${TOPDIR}/../sources/meta-gplv2 \
  ${TOPDIR}/../sources/poky/meta \
  ${TOPDIR}/../sources/poky/meta-poky \
  ${TOPDIR}/../sources/poky/meta-yocto-bsp \
  ${TOPDIR}/../sources/meta-renesas/meta-rz-common \
  ${TOPDIR}/../sources/meta-renesas/meta-rzg2l \
  ${TOPDIR}/../sources/meta-renesas/meta-rzv2h \
  ${@'${TOPDIR}/../sources/meta-renesas/meta-rzv2n' if '${MACHINE}' == 'imdt-v2n-sbc' else ''} \
  ${TOPDIR}/../sources/meta-openembedded/meta-oe \
  ${TOPDIR}/../sources/meta-openembedded/meta-python \
  ${TOPDIR}/../sources/meta-openembedded/meta-multimedia \
  ${TOPDIR}/../sources/meta-imdt-renesas \
  ${TOPDIR}/../sources/meta-swupdate \
  ${@'${IMDT_INTERNAL}' if '${HAS_IMDT_INTERNAL}' == 'True' else ''} \
  ${@'${RZ_FEATURE_GRAPHICS}' if '${HAS_RZ_FEATURE_GRAPHICS}' == 'True' else ''} \
  ${V2H_DRPAI} \
  ${RZ_FEATURE_V2H_CODEC_OCVA} \
  ${RZ_FEATURE_V2N_DRPAI_CODEC_OCVA} \
  "
```

## recipes-support/swupdate/swupdate/defconfig
```kconfig
#
# SWUpdate Settings
#

#
# General Configuration
#
CONFIG_SYSTEMD=y
CONFIG_DEFAULT_CONFIG_FILE="/etc/swupdate.cfg"
CONFIG_SCRIPTS=y
# CONFIG_HW_COMPATIBILITY is not set
CONFIG_SW_VERSIONS_FILE="/etc/sw-versions"

#
# Socket Paths
#
CONFIG_SOCKET_CTRL_PATH=""
CONFIG_SOCKET_PROGRESS_PATH=""
# end of Socket Paths

CONFIG_MTD=y
CONFIG_LUA=y
CONFIG_LUAPKG="lua"
# end of General Configuration

#
# Build Options
#
CONFIG_CROSS_COMPILE=""
CONFIG_SYSROOT=""
CONFIG_EXTRA_CFLAGS=" -O2 -pipe -g -feliminate-unused-debug-types"
CONFIG_EXTRA_LDFLAGS="-Wl,-O1 -Wl,--hash-style=gnu -Wl,--as-needed -Wl,-z,relro,-z,now"
CONFIG_EXTRA_LDLIBS=""
# end of Build Options

#
# Debugging Options
#
# CONFIG_DEBUG is not set
# CONFIG_WERROR is not set
# CONFIG_NOCLEANUP is not set
# end of Debugging Options
# end of SWUpdate Settings

#
# Bootloader support
#

#
# Bootloader Interfaces
#
# CONFIG_BOOTLOADER_NONE is not set
# CONFIG_BOOTLOADER_EBG is not set
CONFIG_UBOOT=y
CONFIG_UBOOT_FWENV="/etc/fw_env.config"
CONFIG_UBOOT_DEFAULTENV="/etc/u-boot-initial-env"
# CONFIG_BOOTLOADER_GRUB is not set
# CONFIG_BOOTLOADER_CBOOT is not set
# end of Bootloader Interfaces

CONFIG_BOOTLOADER_DEFAULT_UBOOT=y
# CONFIG_BOOTLOADER_STATIC_LINKED is not set
CONFIG_UPDATE_STATE_CHOICE_BOOTLOADER=y
CONFIG_UPDATE_STATE_BOOTLOADER=""

#
# Interfaces
#
# CONFIG_DOWNLOAD is not set
# CONFIG_SURICATTA is not set
CONFIG_WEBSERVER=y
CONFIG_MONGOOSE=y
CONFIG_MONGOOSEIPV6=y
CONFIG_MONGOOSESSL=y

#
# Security
#

#
# Crypto libraries
#
CONFIG_SSL_IMPL_OPENSSL=y
# CONFIG_SSL_IMPL_WOLFSSL is not set
# CONFIG_SSL_IMPL_MBEDTLS is not set
# CONFIG_SSL_IMPL_GPGME is not set
# end of Crypto libraries

# CONFIG_HASH_VERIFY is not set
# CONFIG_SIGNED_IMAGES is not set

#
# Encryption
#
# CONFIG_ENCRYPTED_IMAGES is not set
# end of Encryption

#
# Compressors (zlib always on)
#
CONFIG_GUNZIP=y
# CONFIG_XZ is not set
CONFIG_ZSTD=y

#
# Parsers
#

#
# Parser Features
#
CONFIG_LIBCONFIG=y
CONFIG_PARSERROOT=""
# CONFIG_LUAEXTERNAL is not set
# CONFIG_SETSWDESCRIPTION is not set
# end of Parser Features

#
# Handlers
#

#
# Image Handlers
#
CONFIG_ARCHIVE=y
CONFIG_LOCALE=y
CONFIG_BOOTLOADERHANDLER=y
CONFIG_CFI=y
# CONFIG_CFIHAMMING1 is not set
# CONFIG_COPY is not set
# CONFIG_DELTA is not set
# CONFIG_DISKPART is not set
# CONFIG_DISKFORMAT_HANDLER is not set
CONFIG_LUASCRIPTHANDLER=y
# CONFIG_EMBEDDED_LUA_HANDLER is not set
# CONFIG_EMMC_HANDLER is not set
CONFIG_RAW=y
# CONFIG_RDIFFHANDLER is not set
# CONFIG_REMOTE_HANDLER is not set
CONFIG_SHELLSCRIPTHANDLER=y
# CONFIG_SWUFORWARDER_HANDLER is not set
# CONFIG_SSBLSWITCH is not set
# CONFIG_UBIVOL is not set
# CONFIG_UCFWHANDLER is not set
# CONFIG_UNIQUEUUID is not set
# end of Image Handlers

#
# Containers
#

#
# Update containers
#
# CONFIG_DOCKER is not set
# end of Update containers
```
