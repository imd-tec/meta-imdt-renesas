## conf/machine/imdt-rzv2h-evk.conf
```bitbake
#@TYPE: Machine
#@NAME: imdt-rzv2h-evk machine
#@DESCRIPTION: IMDT RZ/V2H Evaluation Board Kit

SOC_FAMILY = "r9a09g057"
require conf/machine/include/rzv2h-common.inc
require conf/machine/include/cip-core.inc

DEFAULTTUNE ?= "cortexa55"

TUNE_CONF ?= "conf/machine/include/tune-cortexa55.inc"
require ${TUNE_CONF}

PREFERRED_PROVIDER_virtual/kernel="linux-renesas"

UBOOT_CONFIG ??= "imdt-rzv2h-evk"
UBOOT_CONFIG[imdt-rzv2h-evk] = "imdt-rzv2h-evk_defconfig"

# flash writer
EXTRA_IMAGEDEPENDS += " flash-writer"

# Supported devicetree
KERNEL_DEVICETREE = " \
	renesas/imdt-rzv2h-evk.dtb \
"

IMAGE_INSTALL_remove = " optee-client"

IMAGE_BOOT_FILES = " \
	bl2_bp_spi-${MACHINE}.srec \
	bl2_bp_emmc-${MACHINE}.srec \
	fip-${MACHINE}.srec \
	Flash_Writer_SCIF_RZV2H_DEV_INTERNAL_MEMORY.mot \
"

WIC_INPUT_DEPENDS = "firmware-pack:do_deploy flash-writer:do_deploy"
```
